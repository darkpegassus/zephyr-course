## app/Kconfig
```kconfig
source "Kconfig.zephyr"

menu "LED Subsystem"

choice LED_BLINK_SLEEP_TIME
    prompt "LED blink sleep time"
    default LED_BLINK_1S

config LED_BLINK_500MS
    bool "500ms (fast)"

config LED_BLINK_1S
    bool "1s (medium)"

config LED_BLINK_2S
    bool "2s (slow)"

endchoice

menuconfig LED_ADVANCED
    bool "Advanced LED settings"

if LED_ADVANCED

config LED_BRIGHTNESS
    int "LED brightness (0-100)"
    range 0 100
    default 100

config LED_FADE_DURATION
    int "LED fade duration (ms)"
    default 500

menu "Expert settings"

config LED_DEBUG
    bool "Enable LED debugging"

config LED_CUSTOM_PATTERN
    bool "Custom blink pattern"

endmenu

endif

endmenu
```

## boards/custom_esp32_scratch/board.yml
```yaml
board:
  name: custom_esp32_scratch
  full_name: Custom ESP32 Scratch Board
  vendor: custom
  socs:
    - name: esp32
```

## drivers/sensor/Kconfig
```kconfig
config LED_SENSOR
    bool "LED sensor driver"
    default y
    depends on GPIO
    select SENSOR
```

## west.yml
```yaml
manifest:
  version: 1.0

  projects:
    - name: zephyr
      url: https://github.com/zephyrproject-rtos/zephyr
      revision: v4.2.0
      import:
        name-allowlist:
          - cmsis_6
          - hal_nxp
          - hal_stm32
          - hal_nordic
        path-prefix: deps

    - name: hal_espressif
      url: https://github.com/zephyrproject-rtos/hal_espressif
      revision: f3453bdeced28642424692aae32cce4eec3f2d7f
      path: deps/modules/hal/espressif
```
